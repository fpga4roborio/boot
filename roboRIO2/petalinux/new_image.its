## roboRIO2/petalinux/new_image.its
```
/dts-v1/;

/ {
    description = "Kernel fitImage for PetaLinux/6.12.10+git/xlnx-zynq-zc702";
    #address-cells = <1>;

    images {
        kernel-1 {
            description = "Linux kernel";
            data = /incbin/("kernel-1");
            type = "kernel";
            arch = "arm";
            os = "linux";
            compression = "none";
            load = <0x00200000>;
            entry = <0x00200000>;
            hash-1 {
                algo = "sha256";
            };
        };

        fdt-1 {
            description = "Flattened Device Tree blob";
            data = /incbin/("ni-7AAE.dtb");
            type = "flat_dt";
            arch = "arm";
            compression = "none";
            hash-1 {
                algo = "sha256";
            };
        };
    };

    configurations {
        default = "conf-1";
        conf-1 {
            description = "1 Linux kernel, FDT blob";
            kernel = "kernel-1";
            fdt = "fdt-1";
            hash-1 {
                algo = "sha256";
            };
        };
    };
};
```
